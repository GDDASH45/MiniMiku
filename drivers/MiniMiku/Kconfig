## drivers/MiniMiku/Kconfig
```kconfig
menu "MiniMiku"

config MINIMIKU_MLOG
	bool "MiniMiku logging device (/dev/mlog)"
	default y
	help
	  Enable the MiniMiku logging device.

	  This option provides the MiniMiku-specific /dev/mlog
	  character device for accessing MiniMiku kernel logs.

	  If unsure, say Y.

config MINIMIKU_INIT
	tristate "MiniMiku initialization module"
	help
	  Build the MiniMiku initialization component as a loadable
	  kernel module or include it directly in the kernel.

endmenu
```

## drivers/MiniMiku/vendor/Kconfig
```kconfig
menu "MiniMiku Hardware vendor"

config MIKU_HWVENDOR
	string "MiniMiku hardware vendor"
	default ""
	help
	  Specifies the hardware vendor name used by MiniMiku.

endmenu
```

## init/MiniMiku/Kconfig
```kconfig
menu "MiniMiku init"

config MINIMIKU_HWNAME
    string "MiniMiku hardware name"
    default ""
    help
      Sets the hardware name exposed by MiniMiku in sysfs.

config MINIMIKU_DORK
    tristate "MiniMiku /dev/dork device"
    default m
    help
      creates /dev/dork, if you want it built in, select y
      if Not. keep it m for module

endmenu
```
